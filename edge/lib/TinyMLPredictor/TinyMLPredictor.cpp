/**
 * @file TinyMLPredictor.cpp
 * @brief TinyML implementation for ESP32
 */

#include "TinyMLPredictor.h"

// TensorFlow Lite includes
#include <TensorFlowLite_ESP32.h>
#include "tensorflow/lite/micro/all_ops_resolver.h"
#include "tensorflow/lite/micro/micro_error_reporter.h"
#include "tensorflow/lite/micro/micro_interpreter.h"
#include "tensorflow/lite/schema/schema_generated.h"

// Model data (generated by convert_to_tflite.py)
#include "model_data.h"

// TFLite globals
namespace {
    tflite::ErrorReporter* error_reporter = nullptr;
    const tflite::Model* model = nullptr;
    tflite::MicroInterpreter* interpreter = nullptr;
    TfLiteTensor* input_tensor = nullptr;
    TfLiteTensor* output_tensor = nullptr;
    
    // Tensor arena (adjust size if needed)
    constexpr int kTensorArenaSize = 4 * 1024;  // 4KB
    uint8_t tensor_arena[kTensorArenaSize];
}

TinyMLPredictor::TinyMLPredictor() {
    bufferIndex = 0;
    readingsCount = 0;
    lastPrediction = -1;
    lastInferenceTime = 0;
    
    // Initialize normalization parameters
    // These values come from training (normalization_params.json)
    // TODO: Update these with actual values from your training
    featureMins[0] = 10.0;   // temperature min
    featureMins[1] = 20.0;   // humidity min
    featureMins[2] = 0.0;    // light min
    featureMins[3] = 0.0;    // hour min
    
    featureRanges[0] = 30.0;  // temperature range
    featureRanges[1] = 75.0;  // humidity range
    featureRanges[2] = 100.0; // light range
    featureRanges[3] = 24.0;  // hour range
}

bool TinyMLPredictor::begin() {
    Serial.println("\n=== Initializing TinyML ===");
    
    // Set up error reporter
    static tflite::MicroErrorReporter micro_error_reporter;
    error_reporter = &micro_error_reporter;
    
    // Load model
    model = tflite::GetModel(model_data);
    if (model->version() != TFLITE_SCHEMA_VERSION) {
        Serial.println("❌ Model schema version mismatch!");
        Serial.print("  Expected: ");
        Serial.println(TFLITE_SCHEMA_VERSION);
        Serial.print("  Got: ");
        Serial.println(model->version());
        return false;
    }
    Serial.println("✓ Model loaded");
    
    // Create interpreter with all ops resolver
    static tflite::AllOpsResolver resolver;
    static tflite::MicroInterpreter static_interpreter(
        model, resolver, tensor_arena, kTensorArenaSize, error_reporter
    );
    interpreter = &static_interpreter;
    
    // Allocate tensors
    TfLiteStatus allocate_status = interpreter->AllocateTensors();
    if (allocate_status != kTfLiteOk) {
        Serial.println("❌ AllocateTensors() failed!");
        return false;
    }
    Serial.println("✓ Tensors allocated");
    
    // Get input and output tensors
    input_tensor = interpreter->input(0);
    output_tensor = interpreter->output(0);
    
    // Print tensor info
    Serial.print("✓ Input shape: (");
    Serial.print(input_tensor->dims->data[1]);
    Serial.print(", ");
    Serial.print(input_tensor->dims->data[2]);
    Serial.println(")");
    
    Serial.print("✓ Output shape: (");
    Serial.print(output_tensor->dims->data[1]);
    Serial.println(")");
    
    Serial.print("✓ Arena used: ");
    Serial.print(interpreter->arena_used_bytes());
    Serial.print(" / ");
    Serial.print(kTensorArenaSize);
    Serial.println(" bytes");
    
    Serial.println("=== TinyML Ready ===\n");
    
    return true;
}

void TinyMLPredictor::addReading(float temperature, float humidity, float lightLevel, float hour) {
    // Add to circular buffer
    tempHistory[bufferIndex] = temperature;
    humidityHistory[bufferIndex] = humidity;
    lightHistory[bufferIndex] = lightLevel;
    hourHistory[bufferIndex] = hour;
    
    // Update index
    bufferIndex = (bufferIndex + 1) % LOOKBACK_STEPS;
    
    // Track number of readings
    if (readingsCount < LOOKBACK_STEPS) {
        readingsCount++;
    }
}

bool TinyMLPredictor::isReady() {
    return readingsCount >= LOOKBACK_STEPS;
}

void TinyMLPredictor::normalizeFeatures(float* features) {
    for (int i = 0; i < N_FEATURES; i++) {
        features[i] = (features[i] - featureMins[i]) / featureRanges[i];
        // Clip to [0, 1]
        features[i] = constrain(features[i], 0.0, 1.0);
    }
}

float TinyMLPredictor::runInference() {
    if (!isReady()) {
        Serial.println("⚠️ Not enough data for prediction");
        return -1;
    }
    
    // Fill input tensor with history (in chronological order)
    for (int t = 0; t < LOOKBACK_STEPS; t++) {
        // Calculate actual index in circular buffer
        int idx = (bufferIndex + t) % LOOKBACK_STEPS;
        
        // Create feature vector
        float features[N_FEATURES] = {
            tempHistory[idx],
            humidityHistory[idx],
            lightHistory[idx],
            hourHistory[idx]
        };
        
        // Normalize
        normalizeFeatures(features);
        
        // Copy to input tensor
        for (int f = 0; f < N_FEATURES; f++) {
            input_tensor->data.f[t * N_FEATURES + f] = features[f];
        }
    }
    
    // Run inference
    unsigned long start = micros();
    TfLiteStatus invoke_status = interpreter->Invoke();
    unsigned long duration = micros() - start;
    
    lastInferenceTime = duration / 1000.0;  // Convert to ms
    
    if (invoke_status != kTfLiteOk) {
        Serial.println("❌ Invoke() failed!");
        return -1;
    }
    
    // Get prediction
    float prediction = output_tensor->data.f[0];
    
    // Clip to valid range
    prediction = constrain(prediction, 0.0, 100.0);
    
    return prediction;
}

float TinyMLPredictor::predict() {
    lastPrediction = runInference();
    
    if (lastPrediction >= 0) {
        Serial.print("🧠 TinyML Prediction: ");
        Serial.print(lastPrediction, 1);
        Serial.print("% (");
        Serial.print(lastInferenceTime, 2);
        Serial.println(" ms)");
    }
    
    return lastPrediction;
}

float TinyMLPredictor::getLastPrediction() {
    return lastPrediction;
}

float TinyMLPredictor::getInferenceTime() {
    return lastInferenceTime;
}

void TinyMLPredictor::reset() {
    bufferIndex = 0;
    readingsCount = 0;
    lastPrediction = -1;
    lastInferenceTime = 0;
}
